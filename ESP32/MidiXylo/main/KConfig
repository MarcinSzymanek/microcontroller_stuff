## ESP32/MidiXylo/main/KConfig
```kconfig
menu "XyloMidi Configuration"
    menu "M-Xylo interrupts"
        
        config PAD_SET_0_INT_PIN
            int "PAD_SET_0_INT_PIN"
            default 4
            help
                Pin number of interrupt for pad set 0 (0-15)

        config SWITCH_INT_PIN
            int "SWITCH_INT_PIN"
            default 5
            help
                Pin number of interrupt for buttons and switches
    endmenu # Pad interrupts
    
    menu "ADC and MUX"

        menu "MUX"
            menu "MUX PADS 0"
            config MUX_P0_PIN_S0
                int "MUX_P0_PIN_S0"
                default 11
            config MUX_P0_PIN_S1
                int "MUX_P0_PIN_S1"
                default 12
            config MUX_P0_PIN_S2
                int "MUX_P0_PIN_S2"
                default 13
            config MUX_P0_PIN_S3
                int "MUX_P0_PIN_S3"
                default 14


            endmenu #MUX PADS 0

            menu "MUX PADS 1"
                config MUX_P1_PIN_S0
                    int "MUX_P1_PIN_S0"
                    default 14
                config MUX_P1_PIN_S1
                    int "MUX_P1_PIN_S1"
                    default 15
                config MUX_P1_PIN_S2
                    int "MUX_P1_PIN_S2"
                    default 16
                config MUX_P1_PIN_S3
                    int "MUX_P1_PIN_S3"
                    default 17

                endmenu #MUX PADS 1

            menu "MUX MISC"
                config MUX_MISC_PIN_S0
                    int "MUX_MISC_PIN_S0"
                    default 15
                config MUX_MISC_PIN_S1
                    int "MUX_MISC_PIN_S1"
                    default 16
                config MUX_MISC_PIN_S2
                    int "MUX_MISC_PIN_S2"
                    default 17
                config MUX_MISC_PIN_S3
                    int "MUX_MISC_PIN_S3"
                    default 18

                endmenu #MUX MISC
        endmenu # MUX menu

        menu "ADC"
            config XMIDI_CHAN_MUX_PADS_0
                int "XMIDI_CHAN_MUX_P0"
                # ADC_1_C9 : pin 10
                default 9
                help
                    ADC channel used by MUX_P0 (Pads 0-15)
                    It is NOT the GPIO pin number
            config XMIDI_CHAN_MUX_PADS_1
                int "XMIDI_CHAN_MUX_P1"
                default 4
                help
                    ADC channel used by MUX_P1 (Pads 16-24)
            config XMIDI_CHAN_MUX_MISC
                int "XMIDI_CHAN_MUX_MISC"
                # adc_1_chan6 : gpio 7
                default 6
                help
                    ADC channel used by MUX_MISC (Buttons 0-11, Knobs 0-3)
        endmenu # ADC menu
    endmenu # ADC and MUX menu

endmenu
```

## ESP32/MuxCtrl/main/Kconfig.projbuild
```kconfig
menu "Mux options"

    orsource "$IDF_PATH/examples/common_components/env_caps/$IDF_TARGET/Kconfig.env_caps"

    config MUX_PINS
        help
            Pin configuration of MUX: choose which gpio control the mux

    choice MUX_PIN_S0
        int "Pin s0"
        range 0 30
    endchoice
    choice MUX_PIN_S1
        int "Pin s1"
        range 0 30
    endchoice
    choice MUX_PIN_S2
        int "Pin s2"
        range 0 30
    endchoice
    choice MUX_PIN_S3
        int "Pin s3"
        range 0 30
    endchoice

endmenu
```

## ESP32/UsbMidi/sdkconfig.defaults
```kconfig
#
# FREERTOS
#
CONFIG_FREERTOS_HZ=1000
# end of FREERTOS

CONFIG_TINYUSB_MIDI_COUNT=1
# end of Component config
```
